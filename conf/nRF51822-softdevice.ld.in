MEMORY
{
	FLASH (rx)  : ORIGIN = @APPLICATION_START_ADDRESS@, LENGTH = @APPLICATION_LENGTH@
	RAM  (rwx) : ORIGIN = @RAM_R1_BASE@, LENGTH = @RAM_APPLICATION_AMOUNT@

}

HEAP_SIZE = @HEAP_SIZE@;

INCLUDE "nRF51822-common.ld"

